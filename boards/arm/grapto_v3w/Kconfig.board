## boards/arm/grapto_v3w/Kconfig.board
```kconfig
# BL653 DVK board configuration

# Copyright (c) 2020 Laird Connectivity
# SPDX-License-Identifier: Apache-2.0

config BOARD_GRAPTO_V3W
	bool "GRAPTO_V3W"
	depends on SOC_NRF52833_QIAA
```
